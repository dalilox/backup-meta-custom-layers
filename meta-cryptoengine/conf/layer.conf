## meta-cryptoengine/conf/layer.conf
```bitbake
# We have a conf and classes directory, add to BBPATH
BBPATH .= ":${LAYERDIR}"

# We have recipes-* directories, add to BBFILES
BBFILES += "${LAYERDIR}/recipes-*/*/*.bb \
            ${LAYERDIR}/recipes-*/*/*.bbappend"

BBFILE_COLLECTIONS += "meta-cryptoengine"
BBFILE_PATTERN_meta-cryptoengine = "^${LAYERDIR}/"
BBFILE_PRIORITY_meta-cryptoengine = "6"

LAYERDEPENDS_meta-cryptoengine = "core"
LAYERSERIES_COMPAT_meta-cryptoengine = "hardknott"
```

## meta-custom-defconfig/conf/layer.conf
```bitbake
# We have a conf and classes directory, add to BBPATH
BBPATH .= ":${LAYERDIR}"

# We have recipes-* directories, add to BBFILES
BBFILES += "${LAYERDIR}/recipes-*/*/*.bb \
            ${LAYERDIR}/recipes-*/*/*.bbappend"

BBFILE_COLLECTIONS += "meta-custom-defconfig"
BBFILE_PATTERN_meta-custom-defconfig = "^${LAYERDIR}/"
BBFILE_PRIORITY_meta-custom-defconfig = "6"

LAYERDEPENDS_meta-custom-defconfig = "core"
LAYERSERIES_COMPAT_meta-custom-defconfig = "hardknott"
```

## meta-githello/conf/layer.conf
```bitbake
# We have a conf and classes directory, add to BBPATH
BBPATH .= ":${LAYERDIR}"

# We have recipes-* directories, add to BBFILES
BBFILES += "${LAYERDIR}/recipes-*/*/*.bb \
            ${LAYERDIR}/recipes-*/*/*.bbappend"

BBFILE_COLLECTIONS += "meta-githello"
BBFILE_PATTERN_meta-githello = "^${LAYERDIR}/"
BBFILE_PRIORITY_meta-githello = "6"

LAYERDEPENDS_meta-githello = "core"
LAYERSERIES_COMPAT_meta-githello = "hardknott"
```

## meta-hellomodule/conf/layer.conf
```bitbake
# We have a conf and classes directory, add to BBPATH
BBPATH .= ":${LAYERDIR}"

# We have recipes-* directories, add to BBFILES
BBFILES += "${LAYERDIR}/recipes-*/*/*.bb \
            ${LAYERDIR}/recipes-*/*/*.bbappend"

BBFILE_COLLECTIONS += "meta-hellomodule"
BBFILE_PATTERN_meta-hellomodule = "^${LAYERDIR}/"
BBFILE_PRIORITY_meta-hellomodule = "6"

LAYERDEPENDS_meta-hellomodule = "core"
LAYERSERIES_COMPAT_meta-hellomodule = "hardknott"
```

## meta-hellopatch/conf/layer.conf
```bitbake
# We have a conf and classes directory, add to BBPATH
BBPATH .= ":${LAYERDIR}"

# We have recipes-* directories, add to BBFILES
BBFILES += "${LAYERDIR}/recipes-*/*/*.bb \
            ${LAYERDIR}/recipes-*/*/*.bbappend"

BBFILE_COLLECTIONS += "meta-hellopatch"
BBFILE_PATTERN_meta-hellopatch = "^${LAYERDIR}/"
BBFILE_PRIORITY_meta-hellopatch = "6"

LAYERDEPENDS_meta-hellopatch = "core"
LAYERSERIES_COMPAT_meta-hellopatch = "hardknott"
```

## meta-optee-hello/conf/layer.conf
```bitbake
# We have a conf and classes directory, add to BBPATH
BBPATH .= ":${LAYERDIR}"

# We have recipes-* directories, add to BBFILES
BBFILES += "${LAYERDIR}/recipes-*/*/*.bb \
            ${LAYERDIR}/recipes-*/*/*.bbappend"

BBFILE_COLLECTIONS += "meta-optee-hello"
BBFILE_PATTERN_meta-optee-hello = "^${LAYERDIR}/"
BBFILE_PRIORITY_meta-optee-hello = "6"

LAYERDEPENDS_meta-optee-hello = "core"
LAYERSERIES_COMPAT_meta-optee-hello = "hardknott"
```

## meta-youssefimx8/conf/layer.conf
```bitbake
# We have a conf and classes directory, add to BBPATH
BBPATH .= ":${LAYERDIR}"

# We have recipes-* directories, add to BBFILES
BBFILES += "${LAYERDIR}/recipes-*/*/*.bb \
${LAYERDIR}/recipes-*/*/*.bbappend"

BBFILE_COLLECTIONS += "youssefimx8"
BBFILE_PATTERN_youssefimx8 = "^${LAYERDIR}/"
BBFILE_PRIORITY_youssefimx8 = "6"
LAYERSERIES_COMPAT_youssefimx8 = "gatesgarth hardknott"
```
